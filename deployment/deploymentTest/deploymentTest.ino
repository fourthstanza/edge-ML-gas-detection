#include <fourthstanza-project-1_inferencing.h>
#include <iostream>
#include <TFT_eSPI.h>
#include <SPI.h>
#include "Free_Fonts.h"

#define BUFFER_SIZE  1800
#define WINDOW_SIZE  80

TFT_eSPI tft = TFT_eSPI();

int xpos = 5;
int ypos = 40;

// Callback function declaration
static int get_signal_data(size_t offset, size_t length, float *out_ptr);

// Raw features copied from test sample (Edge Impulse > Model testing)
static const float input_buffer[BUFFER_SIZE] = {
2.0, 0.9836743418021793, 1.39196810346994, 0.45857462462598764, -0.02106618159913977, 
2.0450270717483874, 1.101296517815955, 1.4693314199734353, 0.45935861218996876, -0.015617314099636445, 
2.0947068939696023, 1.2233231098333999, 1.5482837751108234, 0.45944494705708006, -0.009489704127929563, 
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2.0129106957779603, 1.1624636865384248, 1.5502766397433307, 0.3824133584534323, -0.004285510595377959
};

static float features[WINDOW_SIZE];

int raw_feature_get_data(size_t offset, size_t length, float *out_ptr) {
    memcpy(out_ptr, features + offset, length * sizeof(float));
    return 0;
}

void print_inference_result(ei_impulse_result_t result);

void setup() {
  Serial.begin(9600);
  Serial.println("Begining setup");

  tft.init();
  tft.fillScreen(TFT_BLACK);
  tft.setFreeFont(FSB9);

  Serial.println("Screen initialized.");

  drawtext("Device initialized.\nBeginning run.", TFT_WHITE, 0, ypos);
  Serial.println("Device initialized.\nBeginning run.");
  
  delay(2000);
}

const float *start = input_buffer;
const float *end = input_buffer + BUFFER_SIZE - WINDOW_SIZE;

void loop() {

    static int index = 0;
  
  if (start > end) {
    index = 0;
    start = input_buffer;
  }

  start += 5;

  for (int j = 0; j < WINDOW_SIZE; j++) {
    features[j] = start[j];
  }


  ei_printf("Edge Impulse standalone inferencing (Arduino)\n");

  if (sizeof(features) / sizeof(float) != EI_CLASSIFIER_DSP_INPUT_FRAME_SIZE) {
      ei_printf("The size of your 'features' array is not correct. Expected %lu items, but had %lu\n",
          EI_CLASSIFIER_DSP_INPUT_FRAME_SIZE, sizeof(features) / sizeof(float));
      delay(1000);
      return;
  }

  ei_impulse_result_t result = { 0 };

  // the features are stored into flash, and we don't want to load everything into RAM
  signal_t features_signal;
  features_signal.total_length = sizeof(features) / sizeof(features[0]);
  features_signal.get_data = &raw_feature_get_data;

  // invoke the impulse
  EI_IMPULSE_ERROR res = run_classifier(&features_signal, &result, false /* debug */);
  if (res != EI_IMPULSE_OK) {
      ei_printf("ERR: Failed to run classifier (%d)\n", res);
      return;
  }

  // print inference return code
  ei_printf("run_classifier returned: %d\r\n", res);
  print_inference_result(result);
    
    tft.fillScreen(TFT_BLACK);
    drawtext("Time index: ", TFT_WHITE, xpos, ypos);
    tft.drawNumber(index, xpos, ypos + 40);
    drawtext("Prediction: ", TFT_WHITE, 0, ypos + 80);
    tft.drawFloat(result.classification[1].value, 4, 0, ypos + 120); //take the value of true
    
    index++;
  delay(100);
  
}


void print_inference_result(ei_impulse_result_t result) {

    // Print how long it took to perform inference
    ei_printf("Timing: DSP %d ms, inference %d ms, anomaly %d ms\r\n",
            result.timing.dsp,
            result.timing.classification,
            result.timing.anomaly);

    // Print the prediction results (object detection)
  #if EI_CLASSIFIER_OBJECT_DETECTION == 1
      ei_printf("Object detection bounding boxes:\r\n");
      for (uint32_t i = 0; i < result.bounding_boxes_count; i++) {
          ei_impulse_result_bounding_box_t bb = result.bounding_boxes[i];
          if (bb.value == 0) {
              continue;
          }
          ei_printf("  %s (%f) [ x: %u, y: %u, width: %u, height: %u ]\r\n",
                  bb.label,
                  bb.value,
                  bb.x,
                  bb.y,
                  bb.width,
                  bb.height);
      }

      // Print the prediction results (classification)
  #else
      ei_printf("Predictions:\r\n");
      for (uint16_t i = 0; i < EI_CLASSIFIER_LABEL_COUNT; i++) {
          ei_printf("  %s: ", ei_classifier_inferencing_categories[i]);
          ei_printf("%.5f\r\n", result.classification[i].value);
      }
  #endif

      // Print anomaly result (if it exists)
  #if EI_CLASSIFIER_HAS_ANOMALY
      ei_printf("Anomaly prediction: %.3f\r\n", result.anomaly);
  #endif

  #if EI_CLASSIFIER_HAS_VISUAL_ANOMALY
      ei_printf("Visual anomalies:\r\n");
      for (uint32_t i = 0; i < result.visual_ad_count; i++) {
          ei_impulse_result_bounding_box_t bb = result.visual_ad_grid_cells[i];
          if (bb.value == 0) {
              continue;
          }
          ei_printf("  %s (%f) [ x: %u, y: %u, width: %u, height: %u ]\r\n",
                  bb.label,
                  bb.value,
                  bb.x,
                  bb.y,
                  bb.width,
                  bb.height);
      }
  #endif

}

void drawtext(char *text, uint16_t color, int xp, int yp){
  tft.setCursor(xp,yp);
  tft.setTextColor(color);
  tft.setTextWrap(true);
  tft.print(text);
}
